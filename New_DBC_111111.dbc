VERSION ""

NS_ :

BS_:

BU_: XXX

BO_ 827 NEW_MSG_1: 8 XXX
 SG_ NEW_SIGNAL_1 : 43|12@0+ (1,0) [0|4095] "" XXX

BO_ 1048 NEW_MSG_2: 8 XXX
 SG_ NEW_SIGNAL_1 : 48|9@0+ (1,0) [-255|511] "deg" XXX

BO_ 475 NEW_MSG_3: 8 XXX
 SG_ NEW_SIGNAL_1 : 0|8@1+ (1,0) [0|255] "" XXX
